/*
 * audio.c
 *
 *  Created on: Dec 31, 2017
 *      Author: ondra
 */

#include "audio.h"
#include <stdint.h>
#include <stdbool.h>
#include "main.h"
#include "tim.h"
#include "dma.h"
#include "adc.h"
#include "stm32l0xx_hal.h"
#include <string.h>
#include "arm_math.h"
#include <math.h>
#include <float.h>
#include "arm_const_structs.h"
#include "debug.h"

#define print PRINTF

extern DMA_HandleTypeDef hdma_adc;
extern ADC_HandleTypeDef hadc;

void ftoa(float n, char *res, int afterpoint);

//static const float win_hamming_2048[] = {0.08000000f, 0.08000217f, 0.08000867f, 0.08001950f, 0.08003467f, 0.08005417f, 0.08007801f, 0.08010618f, 0.08013868f, 0.08017551f, 0.08021668f, 0.08026218f, 0.08031201f,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 0.08000217f, 0.08000000f};

static const float win_hamming_1024[] = {0.08000000f, 0.08000868f, 0.08003470f, 0.08007808f, 0.08013881f, 0.08021689f, 0.08031231f, 0.08042507f, 0.08055517f, 0.08070260f, 0.08086736f, 0.08104944f, 0.08124883f,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 0.08000868f, 0.08000000f};

#define NUM_SAMPLES 1024
#define BIN_SIZE (44444.444f / (NUM_SAMPLES/2.0f))
#define PK_MINDIST 1.5f
#define PK_MAXFREQ 20000.0f



volatile bool dma_done = false;
void done_cb(DMA_HandleTypeDef*dma)
{
	dma_done = true;
}


void graph(uint32_t width, uint32_t height, float *values, uint32_t count)
{
  float max = FLT_MIN;
  float min = FLT_MAX;
  for (int i = 0; i < count; i++) {
    float f = values[i];
    if (f < min) min = f;
    if (f > max) max = f;
  }

  int xstep = count / width;

  float ystep = 1; //(float)(max - min) / (float)height;

  // this somehow doenst work now

  char buf[100];
  sprintf(buf, "min %d max %d, ystep %d, h %d\r\n", (int)min*1000, (int)max*1000, (int)ystep*1000, height);
  print(buf);

  for (int i = height-1; i >= 0; i--) {
    float thr = i*ystep;
    for (int j = 0; j < width; j++) {
    	float acu = 0;
    	int cnt = 0;
    	for (int k = j*xstep; k < (j+1)*xstep && k < count; k++, cnt++) {
    		acu += values[k];
    	}
    	acu /= (float)cnt;

      float sample = acu;//values[j*xstep];
      if (sample >= thr) {
        print("#");
      } else {
        print(" ");
      }
    }
    print("\r\n");
  }
}












/**
 * Rolling average centered at a bin
 *
 * @param arr - array of bins
 * @param count - number of bins
 * @param pos - position we're intersted in
 * @param len - size of the rolling window, centered around the position
 * @return average within the window, excluding bin at position 'pos'
 */
static float ravg(float *arr, uint32_t count, uint32_t pos, uint32_t len)
{
    // XXX this needs some adjustments, it's not perfectly centered

    // if we're at the end or beginning, use only bins we have available
    uint32_t from = (pos > len/2 ? pos-len/2 : 0);
    uint32_t to = (pos < count-len/2 ? pos+len/2 : count-1);

    float acu = 0;
    for (uint32_t i = from; i <= to; i++) {
        if (i == pos) continue;
        acu += arr[i];
    }
    acu /= (to - from); // not +1 because we skip the middle

    return acu;
}


/**
 * Quadratic interpolation to find the real peak position and magnitude
 *
 * @param pk - peak struct to store the results in
 * @param values - the bins array
 * @param vcount - size of the bins array
 * @param pos - position of the peak we're triyng to analyze
 */
static void qinterp(struct peak *pk, const float *values, uint32_t vcount, uint32_t pos)
{
    float a = (pos>0?values[pos-1]:values[pos]);
    float b = values[pos];
    float c = (pos<vcount-2?values[pos+1]:values[pos]);

    float p = 0.5 * (a-c)/(a-2*b+c);
    // safeguard
    if (p>0.5 || p<-0.5) p=0;

    pk->position = pos + p;
    pk->magnitude = b - 0.25 * (a - c) * p;
}

/**
 * Detect peaks in a real float spectrum
 *
 * @param peaks - destination for the peak detect algorithm, peaks are sorted from the most important
 * @param pcount - number of peaks to detect
 * @param values - the spectrum as an array of bin magnitudes
 * @param vcount - number of bins in the spectrum
 * @return average level (excluding the peaks)
 */
float pkdetect(struct peak *peaks, uint32_t pcount, float *values, uint32_t vcount)
{
    uint32_t used_peaks = 0;

    // clear the table
    for (uint32_t i = 0; i < pcount; i++) {
        peaks[i].position
          = peaks[i].magnitude
          = peaks[i].weight = 0;
    }

    struct peak pk = {0}; // scratch peak
    float prev = 0;
    float sum = 0;
    for (uint32_t i = 0; i < vcount; i++) {
        float base = ravg(values, vcount, i, 32);
        float raw = values[i];
        float normed = raw / base;
        if (i > 0) {
            // difference from the previous bin (this serves as the primary peak detection factor)
            float diff = normed - prev;

            if (diff > 0) {
                // find the precise position and magnitude
                qinterp(&pk, values, vcount, i);
                // weight for sorting the peaks
                pk.weight = diff * pk.magnitude;

                // !!!! This constant must be adjusted if bin is resized
                if (pk.position >= (PK_MAXFREQ/BIN_SIZE)) {
                	// too high, discard
                	goto pk_done;
                }

                // try to fit it in the peak list
				{
					// first we look if there's one close enough to overwrite it or use instead
					for (uint32_t j = 0; j < pcount; j++) {
						if ((pk.position > peaks[j].position - PK_MINDIST) && (pk.position < peaks[j].position + PK_MINDIST)) { // this number determines the min distance of peaks in bin units
							// replace if we have better weight
							if (peaks[j].weight < pk.weight) {
								peaks[j] = pk;
							} // else discard it
							goto pk_done; // exit the for and skip the following for loop
						}
					}

					// look for a place for this new peak, shift what is behind it
					for (uint32_t j = 0; j < pcount; j++) {
						// peaks are sorted by weight
						if (pk.weight > peaks[j].weight) {
							// shift the tail to make room
							if (used_peaks > 0) {
								for (uint32_t k = used_peaks; k > j; k--) {
									peaks[k] = peaks[k-1];
								}
							}
							peaks[j] = pk;
							if (used_peaks < pcount) used_peaks++; // increment the counter if the list wasn't full yet and grew
							break;
						}
					}
				}

				pk_done:;
            }
        }
        prev = normed;
        sum += raw; // this is rms
    }

    // now remove some area around the found peaks (NOTE: this will cause double removal if two peaks happened to be very close together)
    float pksum = 0;
    const uint32_t pkexpand = 4;
    for (uint32_t i = 0; i < pcount; i++) {
        uint32_t pos = (uint32_t)roundf(peaks[i].position);
        uint32_t from = (pos > pkexpand/2 ? pos-pkexpand/2 : 0);
        uint32_t to = (pos < vcount-pkexpand/2 ? pos+pkexpand/2 : vcount-1);
        for (uint32_t j = from; j <= to; j++) {
            pksum += values[j];
        }
    }

    float noise = (sum - pksum);
    if (noise < 0) noise = 0;
    noise /= vcount;

    // sort the peaks by magnitude (they are now sorted by weight, which is useful for detecting prominence but confusing for practical use later)
    for (uint32_t i = 0; i < pcount-1; i++) {
    	float bestmag = peaks[i].magnitude;
    	uint32_t bmpos = i;
    	for (uint32_t j = i+1; j < pcount; j++) {
    		if (peaks[j].magnitude > bestmag) {
    			bestmag = peaks[j].magnitude;
    			bmpos = j;
    		}
		}
    	if (bmpos != i) {
    		// we found a better peak in the tail, let's swap
    		pk = peaks[i];
    		peaks[i] = peaks[bmpos];
    		peaks[bmpos] = pk;
    	}
	}

    return noise;
}















union {
	uint16_t raw[NUM_SAMPLES];
	float flt[NUM_SAMPLES*2];
} samples;


void audio_capture(struct peak *peaks, uint32_t pcount, float *noise, float *totalpower)
{
	char buf[100];

	print("AUDIO SAMPLING ...\r\n");

	print("Starting capture...\r\n");

	HAL_StatusTypeDef rv = HAL_ADC_Start_DMA(&hadc, (void*)samples.raw, (uint32_t)NUM_SAMPLES);
	assert_param(rv == HAL_OK);

	//__enable_irq();

	hdma_adc.XferCpltCallback = done_cb;
	dma_done = false;

	rv = HAL_TIM_Base_Start(&htim2); // kick it off
	assert_param(rv == HAL_OK);

	print("Capture stared.\r\n");

	// wait ...
	while(!dma_done) {
		HAL_Delay(100);
		print("waiting... ");
	}

	print("\r\nCapture completed.\r\n");


	// basic scaling
	for (int i=NUM_SAMPLES-1; i >= 0; i--) {
		samples.flt[i] = (float)samples.raw[i]/2048.0f;
	}


	// remove DC offset
	float mean;
	arm_mean_f32(samples.flt, NUM_SAMPLES, &mean);
	for (int i = 0; i < NUM_SAMPLES; i++) {
		samples.flt[i] -= mean;
	}

	// zero out the second half (this is needed because otherwise the fft is not padded by zeros and doesn't work right)
	for (int i=NUM_SAMPLES; i < NUM_SAMPLES*2; i++) {
		samples.flt[i] = 0;
	}


	uint32_t bin_count = NUM_SAMPLES/2;
	uint32_t samp_count = NUM_SAMPLES;

	for (int i = samp_count - 1; i >= 0; i--) {
		samples.flt[i * 2 + 1] = 0;                   // imaginary
		samples.flt[i * 2] = samples.flt[i] * win_hamming_1024[i]; // real
	}

	print("FFT...\r\n");
	arm_cfft_f32(&arm_cfft_sR_f32_len1024, samples.flt, 0, true); // bit reversed FFT
	print("Magnitude...\r\n");
	arm_cmplx_mag_f32(samples.flt, samples.flt, bin_count); // get magnitude (extract real values)

	// normalize
	print("Scaling...\r\n");
	arm_scale_f32(samples.flt, (1.0f/bin_count)*1000.0f, samples.flt, bin_count);

	// now we have the spectrum computed in samples.flt

	//graph(128, 22, samples.flt, bin_count/8); // doesnt work for some reason

	// Find the peaks...

	float sum = 0;
	for(uint32_t i = 0; i < bin_count; i++) {
		sum += samples.flt[i];
	}
	*totalpower = sum;

	*noise = pkdetect(peaks, pcount, samples.flt, bin_count);

	for (int i = 0; i < pcount; i++) {
		sprintf(buf, "pk %d at %d Hz, mag ", i+1, (int)roundf((peaks[i].position) * BIN_SIZE));
		print(buf);
		ftoa(peaks[i].magnitude, buf, 6);
		print(buf);
		print("\r\n");
	}

	ftoa(*noise, buf, 6);
	print("Mean noise per bin = ");
	print(buf);
	print("\r\n");

}



// ftoa stuff ---------------

// reverses a string 'str' of length 'len'
void reverse(char *str, int len)
{
    int i=0, j=len-1, temp;
    while (i<j)
    {
        temp = str[i];
        str[i] = str[j];
        str[j] = temp;
        i++; j--;
    }
}

 // Converts a given integer x to string str[].  d is the number
 // of digits required in output. If d is more than the number
 // of digits in x, then 0s are added at the beginning.
int intToStr(int x, char str[], int d)
{
    int i = 0;
    while (x)
    {
        str[i++] = (x%10) + '0';
        x = x/10;
    }

    // If number of digits required is more, then
    // add 0s at the beginning
    while (i < d)
        str[i++] = '0';

    reverse(str, i);
    str[i] = '\0';
    return i;
}

// Converts a floating point number to string.
void ftoa(float n, char *res, int afterpoint)
{
    // Extract integer part
    int ipart = (int)n;

    // Extract floating part
    float fpart = n - (float)ipart;

    // convert integer part to string
    int i = intToStr(ipart, res, 0);

    // check for display option after point
    if (afterpoint != 0)
    {
        res[i] = '.';  // add dot

        // Get the value of fraction part upto given no.
        // of points after dot. The third parameter is needed
        // to handle cases like 233.007
        fpart = fpart * pow(10, afterpoint);

        intToStr((int)fpart, res + i + 1, afterpoint);
    }
}

